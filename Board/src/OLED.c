#include "OLED.h"
#include "IIC.h"


const uint8 table[] =       //80*60压缩图片，用于测试
{
0x00,0x00,0x00,0x00,0x00,0x00,0x00,0x00,0x00,0x00,0x00,0x00,0x00,0x00,0x00,0x00,
0x00,0x00,0x00,0x00,0x00,0x00,0x00,0x00,0x00,0x00,0x00,0x00,0x00,0x00,0x00,0x00,
0x00,0x01,0xFF,0xF8,0x00,0x00,0x00,0x00,0x00,0x00,0x00,0x0F,0xFF,0xFE,0x00,0x00,
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0x00,0x00,0x00,0x00,0x00,0x00,0x00,0x00,/*"奸笑",0*/

};

const uint8 house[]=
{
/*--  μ÷è?á?ò?·ùí???￡oD:\×à??\010.bmp  --*/
/*--  ?í?èx???è=128x64  --*/
0x00,0x00,0x00,0x00,0x00,0x00,0x00,0x00,0x00,0x00,0x00,0x00,0x00,0x00,0x00,0x00,
0x00,0x00,0x00,0x00,0x00,0x00,0x00,0x00,0x00,0x00,0x00,0x00,0x00,0x00,0x00,0x00,
0x00,0x00,0x00,0x00,0x00,0x00,0x00,0x00,0x00,0x00,0x00,0x00,0x00,0x00,0x00,0x00,
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0x1F,0x18,0x00,0x00,0x00,0x00,0x00,0x00,0x00,0x00,0x00,0x00,0x00,0x00,0x00,0x00,

};

const unsigned char  F16x16[] =     //放置中文
{
0x00,0x00,0x00,0x00,0x00,0x00,0x00,0x00,0x00,0x00,0x00,0x00,0x00,0x00,0x00,0x00,/*" ",0*/
0x00,0x00,0x00,0x00,0x00,0x00,0x00,0x00,0x00,0x00,0x00,0x00,0x00,0x00,0x00,0x00,/*" ",0*/

0x00,0x02,0x02,0xFA,0xFA,0xAA,0xAA,0xFF,0xFF,0xAA,0xAA,0xFA,0xFA,0x02,0x02,0x00,
0x00,0x42,0x72,0x72,0x3A,0x7A,0x42,0x4B,0x5B,0x52,0x62,0x62,0x13,0x77,0x66,0x00,/*"惠",1*/
};

/************************************6*8的点阵************************************/
const unsigned char  F6x8[][6] =
{
0x00, 0x00, 0x00, 0x00, 0x00, 0x00,// sp
0x00, 0x00, 0x00, 0x2f, 0x00, 0x00,// !
0x00, 0x00, 0x07, 0x00, 0x07, 0x00,// "
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0x14, 0x14, 0x14, 0x14, 0x14, 0x14,// horiz lines
};
/****************************************8*16的点阵************************************/
const unsigned char  F8X16[]=
{
  0x00,0x00,0x00,0x00,0x00,0x00,0x00,0x00,0x00,0x00,0x00,0x00,0x00,0x00,0x00,0x00,// 0
  0x00,0x00,0x00,0xF8,0x00,0x00,0x00,0x00,0x00,0x00,0x00,0x33,0x30,0x00,0x00,0x00,//! 1
  0x00,0x10,0x0C,0x06,0x10,0x0C,0x06,0x00,0x00,0x00,0x00,0x00,0x00,0x00,0x00,0x00,//" 2
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  0x00,0x06,0x01,0x01,0x02,0x02,0x04,0x04,0x00,0x00,0x00,0x00,0x00,0x00,0x00,0x00,//~ 94
};

void OLED_IIC_Init(void)
{
    IMU_IIC_Init(I2C_1);
    DELAY_MS(500);
    gpio_init(IMU_SCL1, GPO, 0); //初始化SCL
    gpio_init(IMU_SDA1, GPO, 0); //初始化SDA
}

/*********************OLED写数据************************************/
void OLED_WrDat(unsigned char IIC_Data)
{
	IIC_start(I2C_1);
	IIC_send_byte(I2C_1,0x78);
	IIC_send_byte(I2C_1,0x40);			//write data
	IIC_send_byte(I2C_1,IIC_Data);
	IIC_stop(I2C_1);
}
/*********************OLED写命令************************************/
void OLED_WrCmd(unsigned char IIC_Command)
{
	IIC_start(I2C_1);
	IIC_send_byte(I2C_1,0x78);            //Slave address,SA0=0
	IIC_send_byte(I2C_1,0x00);			 //write command
	IIC_send_byte(I2C_1,IIC_Command);
	IIC_stop(I2C_1);
}
/*********************OLED 设置坐标************************************/
void OLED_Set_Pos(unsigned char x, unsigned char y)
{
	OLED_WrCmd(0xb0+y);
	OLED_WrCmd(((x&0xf0)>>4)|0x10);
	OLED_WrCmd((x&0x0f)|0x01);
}
/*********************OLED全屏************************************/
void OLED_Fill(unsigned char bmp_dat)
{
	unsigned char y,x;
	for(y=0;y<8;y++)
	{
		OLED_WrCmd(0xb0+y);
		OLED_WrCmd(0x01);
		OLED_WrCmd(0x10);
		for(x=0;x<X_WIDTH;x++)
		OLED_WrDat(bmp_dat);
	}
}
/*********************OLED复位************************************/
void OLED_CLS(void)
{
	unsigned char y,x;
	for(y=0;y<8;y++)
	{
		OLED_WrCmd(0xb0+y);
		OLED_WrCmd(0x01);
		OLED_WrCmd(0x10);
		for(x=0;x<X_WIDTH;x++)
		OLED_WrDat(0);
	}
}
/*********************OLED初始化************************************/
void OLED_Init(void)
{
    OLED_IIC_Init();//OLED_iic初始化

	DELAY_MS(500);//初始化之前的延时很重要！
	OLED_WrCmd(0xAE); //关闭显示
	OLED_WrCmd(0xD5); //设置时钟分频因子,震荡频率
	OLED_WrCmd(0x50); //[3:0],分频因子;[7:4],震荡频率
	OLED_WrCmd(0xA8); //设置驱动路数
	OLED_WrCmd(0X3F); //默认0X3F(1/64)
	OLED_WrCmd(0xD3); //设置显示偏移
	OLED_WrCmd(0X00); //默认为0
	OLED_WrCmd(0x40); //设置显示开始行 [5:0],行数.
	OLED_WrCmd(0x8D); //电荷泵设置
	OLED_WrCmd(0x14); //bit2，开启/关闭
	OLED_WrCmd(0x20); //设置内存地址模式
	OLED_WrCmd(0x02); //[1:0],00，列地址模式;01，行地址模式;10,页地址模式;默认10;
	OLED_WrCmd(0xA1); //段重定义设置,bit0:0,0->0;1,0->127;
	OLED_WrCmd(0xC8); //设置COM扫描方向;bit3:0,普通模式;1,重定义模式 COM[N-1]->COM0;N:驱动路数
	OLED_WrCmd(0xDA); //设置COM硬件引脚配置
	OLED_WrCmd(0x12); //[5:4]配置
	OLED_WrCmd(0x81); //对比度设置
	OLED_WrCmd(0xEF); //1~255;默认0X7F (亮度设置,越大越亮)
	OLED_WrCmd(0xD9); //设置预充电周期
	OLED_WrCmd(0xf1); //[3:0],PHASE 1;[7:4],PHASE 2;
	OLED_WrCmd(0xDB); //设置VCOMH 电压倍率
	OLED_WrCmd(0x30); //[6:4] 000,0.65*vcc;001,0.77*vcc;011,0.83*vcc;
	OLED_WrCmd(0xA4); //全局显示开启;bit0:1,开启;0,关闭;(白屏/黑屏)
        OLED_WrCmd(0xA6); //设置显示方式;bit0:1,反相显示;0,正常显示
	OLED_WrCmd(0xAF); //开启显示
	OLED_Fill(0x00); //初始清屏
	OLED_Set_Pos(0,0);
}
/***************功能描述：显示6*8一组标准ASCII字符串	显示的坐标（x,y），y为页范围0～7****************/
void OLED_P6x8Str(unsigned char x, unsigned char y, char ch[])
{
	unsigned char c=0,i=0,j=0;
	while (ch[j]!='\0')
	{
		c =ch[j]-32;
		if(x>126){x=0;y++;}
		OLED_Set_Pos(x,y);
		for(i=0;i<6;i++)
		OLED_WrDat(F6x8[c][i]);
		x+=6;
		j++;
	}
}
/*******************功能描述：显示8*16一组标准ASCII字符串	 显示的坐标（x,y），y为页范围0～7****************/
void OLED_P8x16Str(unsigned char x, unsigned char y, char ch[])
{
	unsigned char c=0,i=0,j=0;
	while (ch[j]!='\0')
	{
		c =ch[j]-32;
		if(x>120){x=0;y++;}
		OLED_Set_Pos(x,y);
		for(i=0;i<8;i++)
		OLED_WrDat(F8X16[c*16+i]);
		OLED_Set_Pos(x,y+1);
		for(i=0;i<8;i++)
		OLED_WrDat(F8X16[c*16+i+8]);
		x+=8;
		j++;
	}
}
/*****************功能描述：显示16*16点阵  显示的坐标（x,y），y为页范围0～7****************************/
void OLED_P16x16Ch(unsigned char x, unsigned char y, unsigned char N)
{
	unsigned char wm=0;
	unsigned int adder=32*N;
	OLED_Set_Pos(x , y);
	for(wm = 0;wm < 16;wm++)
	{
		OLED_WrDat(F16x16[adder]);
		adder += 1;
	}
	OLED_Set_Pos(x,y + 1);
	for(wm = 0;wm < 16;wm++)
	{
		OLED_WrDat(F16x16[adder]);
		adder += 1;
	}
}
void OLED_nurbem(uint8 x,uint8 y,uint8 a,uint8 b)
{
  int8 aa[7];
  aa[0]=a/100+'0';
  aa[1]=a%100/10+'0';
  aa[2]=a%10+'0';
  aa[3]='\0';
  if(b==1)
  {
    aa[2]='.';
    aa[3]=a%10+'0';
    aa[4]='\0';
  }
  if(b==2)
  {
    aa[1]='.';
    aa[2]=a%100/10+'0';
    aa[3]=a%10+'0';
    aa[4]='\0';
   }
   if(b==3)
   {
    aa[0]='0';
    aa[1]='.';
    aa[2]=a/100+'0';
    aa[3]=a%100/10+'0';
    aa[4]=a%10+'0';
    aa[5]='\0';
   }
   if(b==4)
   {
     aa[0]='0';
     aa[1]='0';
     aa[2]='.';
     aa[3]=a/100+'0';
     aa[4]=a%100/10+'0';
     aa[5]=a%10+'0';
     aa[6]='\0';
    }
  OLED_P6x8Str(x,y,aa);
}
void OLED_nurbem_int(uint8 x,uint8 y,uint16 a)
{
	int8 aa[6];
	aa[0]=a/10000+'0';
	aa[1]=a%10000/1000+'0';
	aa[2]=a%1000/100+'0';
	aa[3]=a%100/10+'0';
	aa[4]=a%10+'0';
	aa[5]='\0';
	OLED_P8x16Str(x,y,aa);
}

void OLED_Show_Length(uint8 *table)   //显示纵向图片128*64
{
    uint8 y,x;

	for(y = 0; y < 8; y ++)
	{
		OLED_WrCmd(0xb0 + y);
		OLED_WrCmd(0x01);
		OLED_WrCmd(0x10);

		for(x = 0; x < X_WIDTH; x ++)
        {
            OLED_WrDat(*table);
            table ++;
        }
	}
}
void OLED_Show_Cross(uint8 *table, uint8 wide, uint8 high)  //显示横向图片x*y,直接显示压缩图片
{
    uint8 i, x, y;
    uint8 temp = 0;
    uint8 store = 0;

    uint8 line_num;         //八行组成一行，行数
    uint8 leap_line;        //一行偏移字节数
    uint8 leap_group;       //八行偏移字节数
    uint16 max_offset;      //最大偏移地址,注意范围
    uint16 current_offset;   //当前相对偏移地址

    line_num = (high >> 3) + (high % 8 || 0);       //行数不满足八的倍数是增加一行补齐为八的倍数
    leap_line = (wide >> 3) + (wide % 8 || 0);      //宽度不满足八的倍数时增加一列补齐为八的倍数
    leap_group = leap_line << 3;
    max_offset = leap_line * high;

    for(y = 0; y < line_num; y ++)
	{
		OLED_Set_Pos(0, y);
		for(x = 0; x < wide; x ++)
        {
            for(i = 0; i < 8; i ++)
            {
                temp = temp >> 1;
                current_offset = i * leap_line + y * leap_group + (x >> 3);     //计算出当前相对偏移地址
                if(current_offset >= max_offset)
                    store = 0xff;                                               //超出部分显示黑色
                else
                    store = *(table + current_offset);
                temp |= (store << x % 8) & 0x80;
            }
            OLED_WrDat(~temp);
            temp = 0;
        }
	}
}

void OLED_Show_Uncompress(uint8 *Table,uint16 usRowNum, uint16 usColumnNum)
{
    uint8 ucData;
    uint16 i,j,k,m,n;
    uint16 usRowTmp;

    m = usRowNum >> 3;                          //计算图片行数以8位为一组完整的组数
    n = usRowNum % 8;                           //计算分完组后剩下的行数

    for(i = 0; i < m; i++)                      //完整组行扫描
    {
        OLED_Set_Pos(0,(uint8)i);
        usRowTmp = i << 3;                      //计算当前所在行的下标
        for(j = 0; j < usColumnNum; j++)        //列扫描
        {
            ucData = 0;
            for(k = 0; k < 8; k++)              //在i组中对这8行扫描
            {
                ucData = ucData >> 1;
                if((Table + (usRowTmp + k) * usColumnNum)[j] == 0) ;
                 else
                    ucData = ucData | 0x80;
            }
            OLED_WrDat(ucData);
        }
    }
    OLED_Set_Pos(0,(uint8)i);                   //设置剩下的行显示的起始坐标
    usRowTmp = i << 3;                          //计算当前所在行的下标
    for(j = 0; j < usColumnNum; j++)            //列扫描
    {
        ucData = 0;
        for(k = 0; k < n; k++)                  //对剩下的行扫描
        {
            ucData = ucData >> 1;
            if((Table + (usRowTmp + k) * usColumnNum)[j] == LED_IMAGE_WHITE)
            {
                ucData = ucData | 0x80;
            }

        }
        ucData = ucData >> (8 - n);
        OLED_WrDat(ucData);
    }
}

